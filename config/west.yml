## config/west.yml
```yaml
#manifest:
#  remotes:
#    - name: infused-kim
#      url-base: https://github.com/infused-kim
#  projects:
#    - name: zmk
#      remote: infused-kim
#      revision: my-changes/split-encoder
#      import: app/west.yml
#  self:
#    path: config

#manifest:
#  remotes:
#    - name: hadiwidjana
#      url-base: https://github.com/hadiwidjana
#  projects:
#    - name: zmk
#      remote: hadiwidjana
#      revision: my-changes/split-encoder
#      import: app/west.yml
#  self:
#    path: config


manifest:
  remotes:
    - name: zmkfirmware
      url-base: https://github.com/zmkfirmware
  projects:
    - name: zmk
      remote: zmkfirmware
      revision: main
      import: app/west.yml
  self:
    path: config
```
